## main/Kconfig.projbuild
```kconfig
menu "WiFi Repeater"

    config REPEATER_UPSTREAM_SSID
        string "Upstream network SSID (your router)"
        default "MyRouter"

    config REPEATER_UPSTREAM_PASSWORD
        string "Upstream network password"
        default ""

    config REPEATER_AP_SSID
        string "Repeater access point SSID"
        default "ESP32-Repeater"

    config REPEATER_AP_PASSWORD
        string "Repeater access point password (min 8 chars, empty = open)"
        default "changeme123"

    config REPEATER_AP_MAX_CLIENTS
        int "Max clients on the access point"
        range 1 10
        default 8

endmenu
```

## sdkconfig.defaults
```kconfig
CONFIG_IDF_TARGET="esp32c6"
CONFIG_LWIP_IP_FORWARD=y
CONFIG_LWIP_IPV4_NAPT=y
CONFIG_LWIP_IPV4_NAPT_PORTMAP=y
CONFIG_ESP_WIFI_SOFTAP_SUPPORT=y
CONFIG_ESPTOOLPY_FLASHSIZE_8MB=y
CONFIG_PARTITION_TABLE_SINGLE_APP=y
CONFIG_LWIP_MAX_SOCKETS=16
CONFIG_ESP_WIFI_STATIC_RX_BUFFER_NUM=16
CONFIG_ESP_WIFI_DYNAMIC_RX_BUFFER_NUM=64
CONFIG_ESP_WIFI_DYNAMIC_TX_BUFFER_NUM=64
CONFIG_ESP_WIFI_AMPDU_RX_ENABLED=y
CONFIG_ESP_WIFI_AMPDU_TX_ENABLED=y
CONFIG_ESP_WIFI_RX_BA_WIN=16

# Throughput tuning
CONFIG_COMPILER_OPTIMIZATION_PERF=y
CONFIG_ESP_WIFI_IRAM_OPT=y
CONFIG_ESP_WIFI_RX_IRAM_OPT=y
CONFIG_LWIP_IRAM_OPTIMIZATION=y
CONFIG_LWIP_TCPIP_RECVMBOX_SIZE=64
CONFIG_LWIP_TCPIP_TASK_STACK_SIZE=4096
CONFIG_LOG_DEFAULT_LEVEL_WARN=y
CONFIG_FREERTOS_HZ=1000
CONFIG_ESP_WIFI_TX_BA_WIN=16
CONFIG_ESP_WIFI_STATIC_TX_BUFFER_NUM=16
CONFIG_ESP_WIFI_TX_BUFFER_TYPE=0
CONFIG_LWIP_TCP_SND_BUF_DEFAULT=65534
CONFIG_LWIP_TCP_WND_DEFAULT=65534
CONFIG_LWIP_TCP_RECVMBOX_SIZE=64
CONFIG_LWIP_UDP_RECVMBOX_SIZE=64
CONFIG_LWIP_IPV6=n
CONFIG_HTTPD_MAX_REQ_HDR_LEN=1536
```
